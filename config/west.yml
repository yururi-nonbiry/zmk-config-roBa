## config/west.yml
```yaml
manifest:
  remotes:
    - name: zmkfirmware
      url-base: https://github.com/zmkfirmware
    - name: kumamuk-git
      url-base: https://github.com/kumamuk-git
    - name: caksoylar
      url-base: https://github.com/caksoylar
    - name: yururi-nonbiry
      url-base: https://github.com/yururi-nonbiry
    - name: amgskobo
      url-base: https://github.com/amgskobo
  projects:
    - name: zmk
      remote: zmkfirmware
      revision: main
      import: app/west.yml
    - name: zmk-pmw3610-driver
      remote: kumamuk-git
      revision: main
    - name: zmk-rgbled-widget
      remote: caksoylar
      revision: main
    - name: zmk-driver-azoteq-iqs5xx
      remote: yururi-nonbiry
      revision: main
    - name: zmk-input-inertia
      remote: amgskobo
      revision: main
  self:
    path: config
```
